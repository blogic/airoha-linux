## Documentation/devicetree/bindings/pinctrl/airoha,an7589-pinctrl.yaml
```yaml
# SPDX-License-Identifier: (GPL-2.0 OR BSD-2-Clause)
%YAML 1.2
---
$id: http://devicetree.org/schemas/pinctrl/airoha,an7589-pinctrl.yaml#
$schema: http://devicetree.org/meta-schemas/core.yaml#

title: Airoha AN7589 Pin Controller

maintainers:
  - John Crispin <john@phrozen.org>

description:
  The Airoha AN7589 pin controller is used to control SoC pins. Pin
  functions are selected through a separate IOMUX register block, one
  mode field per pin. Every pin is a GPIO in mode 0.

properties:
  compatible:
    const: airoha,an7589-pinctrl

  airoha,iomux:
    $ref: /schemas/types.yaml#/definitions/phandle
    description:
      Phandle to the IOMUX syscon holding the per pin mode fields.

  interrupts:
    maxItems: 1

  gpio-controller: true

  '#gpio-cells':
    const: 2

  gpio-ranges:
    maxItems: 1

  interrupt-controller: true

  '#interrupt-cells':
    const: 2

allOf:
  - $ref: pinctrl.yaml#

required:
  - compatible
  - airoha,iomux
  - interrupts
  - gpio-controller
  - "#gpio-cells"
  - interrupt-controller
  - "#interrupt-cells"

patternProperties:
  '-pins$':
    type: object

    patternProperties:
      '^mux(-|$)':
        type: object

        description:
          pinmux configuration nodes.

        $ref: /schemas/pinctrl/pinmux-node.yaml

        properties:
          function:
            description:
              A string containing the name of the function to mux to the group.
            enum: [uart, i2c, spi, pcm, pcm_spi, i2s, mdio, mdcs, mdios, emmc,
                   pcie, pon, sgpio, watchdog, shiftmux_spi, tod, sync_e, jtag,
                   pwm]

          groups:
            description:
              An array of strings. Each string contains the name of a group.
            items:
              enum: [uart1, uart2, uart3, uart3_alt, uart4, uart5, uart5_alt,
                     uart5_full, uart6, uart6_full, i2c0, i2c1, i2c2, i2c3,
                     i2c4, spi0, ext_spi0_full, ext_spi1, ext_spi1_full,
                     ext_spi2, ext_spi2_full, ext_spi3, ext_spi3_full, pcm1,
                     pcm2, pcm_spi, pcm_spi_cs, pcm_ctrl, i2s, mdio0, mdio1,
                     mdio2, mdcs, mdios, emmc, pcie0_rst, pcie0_clkreq,
                     pcie0_wake, pcie1_rst, pcie1_clkreq, pcie1_wake, pcie2_rst,
                     pcie2_clkreq, pcie2_wake, pon1, pon2, sgpio0, sgpio1,
                     watchdog, shiftmux_spi, tod, sync_e, cpu_jtag,
                     cpu_jtag_alt, npu_jtag, ibex_jtag, pma50eth_jtag,
                     ainpu_jtag, pma50pon_jtag, gpio0, gpio1, gpio2, gpio3,
                     gpio4, gpio5, gpio6, gpio7, gpio8, gpio9, gpio10, gpio11,
                     gpio12, gpio13, gpio14, gpio15]

        required:
          - function
          - groups

        allOf:
          - if:
              properties:
                function:
                  const: uart
            then:
              properties:
                groups:
                  items:
                    enum: [uart1, uart2, uart3, uart3_alt, uart4, uart5,
                           uart5_alt, uart5_full, uart6, uart6_full]
                  maxItems: 1
          - if:
              properties:
                function:
                  const: i2c
            then:
              properties:
                groups:
                  items:
                    enum: [i2c0, i2c1, i2c2, i2c3, i2c4]
                  maxItems: 1
          - if:
              properties:
                function:
                  const: spi
            then:
              properties:
                groups:
                  items:
                    enum: [spi0, ext_spi0_full, ext_spi1, ext_spi1_full,
                           ext_spi2, ext_spi2_full, ext_spi3, ext_spi3_full]
                  maxItems: 1
          - if:
              properties:
                function:
                  const: pcm
            then:
              properties:
                groups:
                  items:
                    enum: [pcm1, pcm2]
                  maxItems: 1
          - if:
              properties:
                function:
                  const: pcm_spi
            then:
              properties:
                groups:
                  items:
                    enum: [pcm_spi, pcm_spi_cs, pcm_ctrl]
                  maxItems: 3
          - if:
              properties:
                function:
                  const: i2s
            then:
              properties:
                groups:
                  enum: [i2s]
          - if:
              properties:
                function:
                  const: mdio
            then:
              properties:
                groups:
                  items:
                    enum: [mdio0, mdio1, mdio2]
                  maxItems: 1
          - if:
              properties:
                function:
                  const: mdcs
            then:
              properties:
                groups:
                  enum: [mdcs]
          - if:
              properties:
                function:
                  const: mdios
            then:
              properties:
                groups:
                  enum: [mdios]
          - if:
              properties:
                function:
                  const: emmc
            then:
              properties:
                groups:
                  enum: [emmc]
          - if:
              properties:
                function:
                  const: pcie
            then:
              properties:
                groups:
                  items:
                    enum: [pcie0_rst, pcie0_clkreq, pcie0_wake, pcie1_rst,
                           pcie1_clkreq, pcie1_wake, pcie2_rst, pcie2_clkreq,
                           pcie2_wake]
                  maxItems: 3
          - if:
              properties:
                function:
                  const: pon
            then:
              properties:
                groups:
                  items:
                    enum: [pon1, pon2]
                  maxItems: 1
          - if:
              properties:
                function:
                  const: sgpio
            then:
              properties:
                groups:
                  items:
                    enum: [sgpio0, sgpio1]
                  maxItems: 1
          - if:
              properties:
                function:
                  const: watchdog
            then:
              properties:
                groups:
                  enum: [watchdog]
          - if:
              properties:
                function:
                  const: shiftmux_spi
            then:
              properties:
                groups:
                  enum: [shiftmux_spi]
          - if:
              properties:
                function:
                  const: tod
            then:
              properties:
                groups:
                  enum: [tod]
          - if:
              properties:
                function:
                  const: sync_e
            then:
              properties:
                groups:
                  enum: [sync_e]
          - if:
              properties:
                function:
                  const: jtag
            then:
              properties:
                groups:
                  items:
                    enum: [cpu_jtag, cpu_jtag_alt, npu_jtag, ibex_jtag,
                           pma50eth_jtag, ainpu_jtag, pma50pon_jtag]
                  maxItems: 1
          - if:
              properties:
                function:
                  const: pwm
            then:
              properties:
                groups:
                  items:
                    enum: [gpio0, gpio1, gpio2, gpio3, gpio4, gpio5, gpio6,
                           gpio7, gpio8, gpio9, gpio10, gpio11, gpio12, gpio13,
                           gpio14, gpio15]
                  maxItems: 1

        additionalProperties: false

      '^conf(-|$)':
        type: object

        description:
          pinconf configuration nodes.

        $ref: /schemas/pinctrl/pincfg-node.yaml

        properties:
          pins:
            description:
              An array of strings. Each string contains the name of a pin.
            items:
              pattern: '^gpio([0-9]|[1-6][0-9]|7[0-3])$'
            minItems: 1
            maxItems: 12

          input-enable: true

          output-enable: true

          output-low: true

          output-high: true

        required:
          - pins

        additionalProperties: false

    additionalProperties: false

additionalProperties: false

examples:
  - |
    #include <dt-bindings/interrupt-controller/arm-gic.h>

    pinctrl {
      compatible = "airoha,an7589-pinctrl";
      airoha,iomux = <&iomux>;

      interrupt-parent = <&gic>;
      interrupts = <GIC_SPI 82 IRQ_TYPE_LEVEL_HIGH>;

      gpio-controller;
      #gpio-cells = <2>;

      interrupt-controller;
      #interrupt-cells = <2>;

      gpio-ranges = <&pinctrl 0 0 74>;

      mmc-pins {
        mux {
          function = "emmc";
          groups = "emmc";
        };
      };

      pcie0-pins {
        mux {
          function = "pcie";
          groups = "pcie0_rst", "pcie0_clkreq", "pcie0_wake";
        };
      };

      uart5-pins {
        mux {
          function = "uart";
          groups = "uart5_full";
        };
      };
    };
```
